## config/boards/shields/corne_xiao_direct/Kconfig.defconfig
```kconfig
if SHIELD_CORNE_XIAO_DIRECT_LEFT || SHIELD_CORNE_XIAO_DIRECT_RIGHT

config ZMK_KEYBOARD_NAME
    default "Corne Xiao Direct"

config ZMK_SPLIT
    default y

endif
```

## config/boards/shields/corne_xiao_direct/Kconfig.shield
```kconfig
config SHIELD_CORNE_XIAO_DIRECT_LEFT
    def_bool $(shields_list_contains,corne_xiao_direct_left)

config SHIELD_CORNE_XIAO_DIRECT_RIGHT
    def_bool $(shields_list_contains,corne_xiao_direct_right)
```
